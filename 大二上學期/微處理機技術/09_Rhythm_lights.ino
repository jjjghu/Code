// void playTone(int period, int duration)
// {
//   int pulse = period / 2;
//   for(long i = 0; i < duration * 1000L; i+= period)
//   {
//     digitalWrite(speakerPin, HIGH);
//     delayMicroseconds(pulse);
//     digitalWrite(speakerPin, LOW);
//     delayMicroseconds(pulse);
//   }
// }
int vibration = -5; // 控制亮度變化
int brightness = 255; // 亮度
int interval = 1000; // 亮度變化間隔
int startTime = 0; // 利用時間控制亮度變化
const int speakerPin = 9; // buzzer
void setup() 
{
  Serial.begin(9600); // 方便觀察
  startTime = millis(); // 初始化起始時間
  pinMode(speakerPin, OUTPUT); // 蜂鳴器輸出
}
int list[] = {125, 125, 250, 250, 125, 250, 250, 125, 125, 125, 125, 125, 125,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 125, 125};
int song[] = {294, 294, 587, 440, 415, 392, 349, 294, 349, 392, 262, 262, 262,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 587, 587};
int delays[] {125, 125, 250, 375, 250, 250, 250, 125, 125, 125, 62 , 62 , 62 ,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 125, 125};
void loop()
{
  for(int i = 0; i < sizeof(song) / sizeof(int); i++)
  {
    tone(speakerPin, song[i], list[i]); // 內建tone指令
    delay(delays[i]);
    if(millis() - startTime >= interval) // 到達呼吸時間
    {
      if(brightness >= 255) vibration = -5; // 亮度控制
      else if(brightness <= 0) vibration = 5; // 同上
      brightness += vibration; // 更新亮度
      analogWrite(LED_BUILTIN, brightness); // 寫入亮度
      Serial.println(brightness); // 方便觀察, 非必要
      startTime = millis(); // 更新起始時間
    }
  }
  // delay(2000); // 重新開始 
}